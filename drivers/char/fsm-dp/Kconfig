## drivers/char/fsm-dp/Kconfig
```kconfig
menuconfig FSM_DP
	tristate "FSM DP Interface Core"
	depends on MHI_BUS
	default m
	help
	  FSM DP driver interface. The FSM DP character driver
	  provides a datapath server to user space.
```
